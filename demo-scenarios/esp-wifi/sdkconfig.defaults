## demo-scenarios/esp-wifi/sdkconfig.defaults
```kconfig
CONFIG_ESP_WIFI_SOFTAP_SUPPORT=n
CONFIG_ESP_WIFI_SSID="MyHomeWiFi"
CONFIG_ESP_WIFI_PASSWORD="changeme"
CONFIG_ESP_MAXIMUM_RETRY=5
CONFIG_ESP_WIFI_AUTH_WPA2_PSK=y
```
